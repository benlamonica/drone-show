/*------------------------------------------------------------------------------
* test_rtk.c : end-to-end RTK tests through the real UBX byte path
*
* Every epoch is generated by the simulator, encoded to UBX, and fed to the
* engine one byte at a time -- the same code path the firmware runs. Assertions
* are on the things that matter operationally: does it reach a fix, how long
* does it take, how accurate is it, and does it survive the disturbances a
* drone actually sees (cycle slips, base link dropouts, satellites setting).
*-----------------------------------------------------------------------------*/
#include "sim_scenario.h"
#include "test_util.h"
#include <string.h>
#include <stdlib.h>


typedef struct {
    int nsol, nfix, nfloat, nsingle;
    int first_fix_epoch;
    double rms_h, rms_3d;       /* over fixed epochs                        */
    double max_h;
    double rms_h_all;           /* over every solved epoch                  */
    uint32_t max_us, mean_us;
} run_result_t;

/* One engine and one scenario serve every test, lent by the caller through
 * test_rtk_suite(): main() below allocates them for the host, and the
 * on-target runner (app/test_target.c) does the same on the RP2350. Each test
 * re-initialises both. Two static engines here used to be 340 KB of bss,
 * which left the target too little heap for the engine to start. */
static rtkeng_t *g_eng;
static sim_scenario_t *g_sim;

/* Epoch buffers for the tests that drive the simulator by hand: ~7 KB, well
 * past the 8 KB the RP2350 gives core 0's stack once RTKLIB is on top. */
static obsd_t g_obs[SIM_MAXSAT];
static ubx_meas_aux_t g_aux[SIM_MAXSAT];
static unsigned char g_buf[UBX_MAX_MSG];

/* Run `nepoch` epochs and summarise. `warmup` epochs are excluded from the
 * accuracy statistics so convergence does not pollute the steady-state numbers. */
static void run_scenario(const sim_scenario_cfg_t *scfg, const rtkeng_cfg_t *ecfg,
                         int nepoch, int warmup, run_result_t *res,
                         void (*hook)(sim_scenario_t*,rtkeng_t*,int))
{
    sim_scenario_t *s=g_sim;
    rtkeng_t *eng=g_eng;
    rtkeng_cfg_t cfg=*ecfg;
    double herr,e3d,sh=0,s3=0,sh_all=0;
    int i,nh=0,nall=0;

    memset(res,0,sizeof(*res));
    res->first_fix_epoch=-1;

    sim_scenario_init(s,scfg);
    /* the engine must be told where the base actually is */
    memcpy(cfg.base_ecef,s->base.pos,sizeof(double)*3);

    if (!rtkeng_init(eng,&cfg)) { printf("  rtkeng_init FAILED\n"); return; }

    for (i=0;i<nepoch;i++) {
        if (hook) hook(s,eng,i);
        if (!sim_scenario_step(s,eng)) continue;

        res->nsol++;
        switch (eng->rtk.sol.stat) {
            case SOLQ_FIX:    res->nfix++;    break;
            case SOLQ_FLOAT:  res->nfloat++;  break;
            case SOLQ_SINGLE: res->nsingle++; break;
            default: break;
        }
        if (eng->rtk.sol.stat==SOLQ_FIX&&res->first_fix_epoch<0) {
            res->first_fix_epoch=i;
        }
        if (i<warmup) continue;

        sim_scenario_error(s,eng,&herr,&e3d);
        if (eng->rtk.sol.stat!=SOLQ_NONE) {
            sh_all+=herr*herr; nall++;
        }
        if (eng->rtk.sol.stat==SOLQ_FIX) {
            sh+=herr*herr; s3+=e3d*e3d; nh++;
            if (herr>res->max_h) res->max_h=herr;
        }
    }
    res->rms_h    =nh  ?sqrt(sh/nh)      :-1.0;
    res->rms_3d   =nh  ?sqrt(s3/nh)      :-1.0;
    res->rms_h_all=nall?sqrt(sh_all/nall):-1.0;
    res->max_us   =eng->stats.max_us;
    res->mean_us  =eng->stats.solutions?
                   (uint32_t)(eng->stats.total_us/eng->stats.solutions):0;
    rtkeng_free(eng);
}

static void report(const char *name, const run_result_t *r)
{
    printf("  [%s] sol=%d fix=%d float=%d single=%d  first fix @epoch %d\n",
           name,r->nsol,r->nfix,r->nfloat,r->nsingle,r->first_fix_epoch);
    printf("  [%s] fixed RMS: %.4f m horiz, %.4f m 3D, max %.4f m; "
           "all-solution horiz RMS %.4f m\n",
           name,r->rms_h,r->rms_3d,r->max_h,r->rms_h_all);
    printf("  [%s] rtkpos(): mean %u us, worst %u us\n",name,r->mean_us,r->max_us);
}

/* --- 1. static rover, short baseline -------------------------------------- */
static void test_static_short_baseline(void)
{
    sim_scenario_cfg_t scfg;
    rtkeng_cfg_t ecfg;
    run_result_t r;

    TEST_BEGIN("static rover, 1.2 km baseline, GPS+Galileo");

    sim_scenario_default(&scfg);
    scfg.motion=SIM_MOTION_STATIC;
    rtkeng_default_cfg(&ecfg);
    ecfg.mode=PMODE_STATIC;
    ecfg.dynamics=0;

    run_scenario(&scfg,&ecfg,180,60,&r,NULL);
    report("static",&r);

    CHECK(r.nsol>=170,"solutions produced for essentially every epoch (%d/180)",r.nsol);
    CHECK(r.first_fix_epoch>=0&&r.first_fix_epoch<60,
          "ambiguities fixed within 60 epochs (at %d)",r.first_fix_epoch);
    CHECK(r.nfix>=140,"stays fixed (%d fixed epochs)",r.nfix);
    CHECK(r.rms_h>=0.0&&r.rms_h<0.05,
          "fixed horizontal RMS %.4f m < 5 cm",r.rms_h);
    CHECK(r.max_h<0.15,"worst fixed horizontal error %.4f m < 15 cm",r.max_h);
}

/* --- 2. moving rover ------------------------------------------------------ */
static void test_kinematic(void)
{
    sim_scenario_cfg_t scfg;
    rtkeng_cfg_t ecfg;
    run_result_t r;

    TEST_BEGIN("kinematic rover, 30 m circle at 8 m/s");

    sim_scenario_default(&scfg);
    scfg.motion=SIM_MOTION_CIRCLE;
    scfg.radius=30.0;
    scfg.speed=8.0;
    rtkeng_default_cfg(&ecfg);
    ecfg.mode=PMODE_KINEMA;
    /* dynamics=0: the engine default, 2.5x cheaper, and the only setting that
     * behaves under RTKLIB 2.4.3 -- see "Known limitations" in the README. */
    ecfg.dynamics=0;

    run_scenario(&scfg,&ecfg,240,60,&r,NULL);
    report("kinematic",&r);

    CHECK(r.nsol>=230,"solutions for essentially every epoch (%d/240)",r.nsol);
    CHECK(r.first_fix_epoch>=0,"reaches a fixed solution (epoch %d)",
          r.first_fix_epoch);
    CHECK(r.nfix>=150,"holds the fix while moving (%d fixed epochs)",r.nfix);
    CHECK(r.rms_h>=0.0&&r.rms_h<0.10,
          "fixed horizontal RMS %.4f m < 10 cm while moving",r.rms_h);
}

/* --- 3. cycle slips ------------------------------------------------------- */
static int g_slip_epoch_mod=0;
static void slip_hook(sim_scenario_t *s, rtkeng_t *eng, int epoch)
{
    (void)eng;
    /* Knock out two satellites every g_slip_epoch_mod epochs: a drone banking
     * hard, or a rotor blade chopping the sky view. */
    if (g_slip_epoch_mod&&epoch>0&&epoch%g_slip_epoch_mod==0) {
        int k=(epoch/g_slip_epoch_mod)%s->con.n;
        sim_force_slip(&s->rover,s->con.sat[k]);
        sim_force_slip(&s->rover,s->con.sat[(k+3)%s->con.n]);
    }
}

static void test_cycle_slips(void)
{
    sim_scenario_cfg_t scfg;
    rtkeng_cfg_t ecfg;
    run_result_t r;

    TEST_BEGIN("recurring cycle slips on the rover");

    sim_scenario_default(&scfg);
    scfg.motion=SIM_MOTION_CIRCLE;
    rtkeng_default_cfg(&ecfg);
    g_slip_epoch_mod=10;

    run_scenario(&scfg,&ecfg,240,60,&r,slip_hook);
    g_slip_epoch_mod=0;
    report("slips",&r);

    CHECK(r.nsol>=230,"keeps solving through slips (%d/240)",r.nsol);
    CHECK(r.nfix+r.nfloat>=200,
          "stays in a carrier-phase solution (%d fix + %d float)",
          r.nfix,r.nfloat);
    CHECK(r.rms_h_all>=0.0&&r.rms_h_all<1.0,
          "horizontal RMS over all solutions %.4f m < 1 m",r.rms_h_all);
}

/* --- 3b. half-cycle-subtracted satellites --------------------------------- */
#define HALF_SUB_EPOCHS 180
static int g_half_nvalid, g_half_nlong;
static void half_sub_hook(sim_scenario_t *s, rtkeng_t *eng, int epoch)
{
    int k;
    if (epoch==0) {
        for (k=0;k<s->con.n;k++) s->rover.half_sub[s->con.sat[k]-1]=1;
    }
    else if (epoch==HALF_SUB_EPOCHS-1) {
        /* Every slip zeroes the ambiguity and resets lock, so a satellite that
         * has been in view throughout should have ~one lock count per epoch. */
        g_half_nvalid=g_half_nlong=0;
        for (k=0;k<s->con.n;k++) {
            const ssat_t *ss=&eng->rtk.ssat[s->con.sat[k]-1];
            if (!ss->vsat[0]) continue;
            g_half_nvalid++;
            if (ss->lock[0]>=100) g_half_nlong++;
        }
    }
}

static void test_half_cycle_subtracted(void)
{
    sim_scenario_cfg_t scfg;
    rtkeng_cfg_t ecfg;
    run_result_t r;

    /* The M8P sets RAWX trkStat bit 3 on most satellites once it has resolved
     * the half-cycle, which ublox.c turns into LLI_HALFS (0x80). detslp_ll()
     * used to OR that into the bits where it keeps the previous LLI, so it
     * saw a half-cycle transition and reset the ambiguity every epoch. In the
     * field that was FLOAT -> FIX -> NONE on 7 satellites. The simulator's 24
     * satellites fix even from single-epoch ambiguities, so the fix rate alone
     * does not catch it; carrier lock does. */
    TEST_BEGIN("half-cycle-subtracted satellites (trkStat bit 3)");

    sim_scenario_default(&scfg);
    scfg.motion=SIM_MOTION_STATIC;
    rtkeng_default_cfg(&ecfg);
    ecfg.mode=PMODE_STATIC;
    ecfg.dynamics=0;

    run_scenario(&scfg,&ecfg,HALF_SUB_EPOCHS,60,&r,half_sub_hook);
    report("half-sub",&r);

    CHECK(g_half_nvalid>=4&&g_half_nlong*2>=g_half_nvalid,
          "ambiguities kept, not reset each epoch (%d of %d sats locked >=100 epochs)",
          g_half_nlong,g_half_nvalid);
    CHECK(r.first_fix_epoch>=0&&r.first_fix_epoch<60,
          "ambiguities fixed within 60 epochs (at %d)",r.first_fix_epoch);
    CHECK(r.nfix>=140,"stays fixed (%d fixed epochs)",r.nfix);
}

/* --- 4. base station link dropout ----------------------------------------- */
static void test_base_outage(void)
{
    sim_scenario_t *s=g_sim;
    rtkeng_t *eng=g_eng;
    sim_scenario_cfg_t scfg;
    rtkeng_cfg_t ecfg;
    double herr,e3d;
    int i,n,len,fixed_before=0,degraded_during=0,recovered=0;

    TEST_BEGIN("base link dropout and recovery");

    sim_scenario_default(&scfg);
    rtkeng_default_cfg(&ecfg);
    sim_scenario_init(s,&scfg);
    memcpy(ecfg.base_ecef,s->base.pos,sizeof(double)*3);
    ecfg.max_age=10.0;
    rtkeng_init(eng,&ecfg);

    for (i=0;i<80;i++) sim_scenario_step(s,eng);
    fixed_before=(eng->rtk.sol.stat==SOLQ_FIX);
    CHECK(fixed_before,"fixed before the outage");

    /* 40 epochs of rover-only data: the base stream is cut entirely. */
    for (i=0;i<40;i++) {
        n=sim_observe(&s->con,&s->rover,&s->cfg.err,s->time,s->cfg.base_llh,
                      g_obs,g_aux,SIM_MAXSAT);
        len=ubx_encode_rawx(g_buf,sizeof(g_buf),s->time,g_obs,n,g_aux);
        rtkeng_rover_buf(eng,g_buf,len);
        s->time=timeadd(s->time,1.0);
        s->epoch++;
    }
    /* Once the correction ages past max_age, rtkpos() must fall back to the
     * single-point solution rather than reporting a stale fix. */
    degraded_during=(eng->rtk.sol.stat!=SOLQ_FIX);
    CHECK(degraded_during,"drops out of FIX when corrections age out (stat=%d)",
          eng->rtk.sol.stat);
    sim_scenario_error(s,eng,&herr,&e3d);
    CHECK(herr<15.0,"still a usable single-point position (%.2f m)",herr);

    for (i=0;i<90;i++) sim_scenario_step(s,eng);
    recovered=(eng->rtk.sol.stat==SOLQ_FIX||eng->rtk.sol.stat==SOLQ_FLOAT);
    sim_scenario_error(s,eng,&herr,&e3d);
    CHECK(recovered,"recovers a carrier-phase solution after the link returns "
          "(stat=%d)",eng->rtk.sol.stat);
    CHECK(herr<0.5,"back to %.4f m horizontal",herr);

    rtkeng_free(eng);
}

/* --- 6. GLONASS ------------------------------------------------------------ */
#if NSATGLO>0
/* One hook for the GLONASS scenarios: optional per-channel code biases on the
 * rover, optional receiver-wide lock losses, and a count of GLONASS
 * satellites in the solution on the last epoch. */
static int g_glo_ifb, g_glo_lockloss_s, g_glo_last, g_glo_used;
static void glo_hook(sim_scenario_t *s, rtkeng_t *eng, int epoch)
{
    int k;
    if (epoch==0&&g_glo_ifb) {
        /* The field capture (M8P base and rover, 2026-09-21) showed GLONASS
         * code DDs offset by +3..+7 m per satellite. Different channels, same
         * hardware pair: a fixed, channel-dependent bias on one receiver. */
        static const double ifb[14]={
            4.1,-1.8,5.6,2.4,6.9,0.7,3.3,5.0,-2.6,4.4,1.2,6.1,-0.9,3.8
        };
        for (k=0;k<14;k++) s->rover.glo_code_bias[k]=ifb[k];
    }
    if (g_glo_lockloss_s&&epoch>0&&epoch%g_glo_lockloss_s==0) {
        /* every satellite at once, as the field receiver did every ~25 s */
        for (k=0;k<s->con.n;k++) sim_force_slip(&s->rover,s->con.sat[k]);
    }
    if (epoch==g_glo_last) {
        g_glo_used=0;
        for (k=0;k<s->con.n;k++) {
            int sat=s->con.sat[k];
            if (satsys(sat,NULL)==SYS_GLO&&eng->rtk.ssat[sat-1].vsat[0]) g_glo_used++;
        }
    }
}

static void glo_scenario(const char *name, int kinematic, int ifb, int lockloss_s,
                         int rtcm, int nepoch, run_result_t *r)
{
    sim_scenario_cfg_t scfg;
    rtkeng_cfg_t ecfg;

    sim_scenario_default(&scfg);
    scfg.motion=kinematic?SIM_MOTION_CIRCLE:SIM_MOTION_STATIC;
    rtkeng_default_cfg(&ecfg);
    ecfg.mode=kinematic?PMODE_KINEMA:PMODE_STATIC;
    ecfg.dynamics=0;
    if (rtcm) {
        scfg.base_fmt=SIM_BASE_RTCM3;
        ecfg.base_fmt=RTKENG_BASE_RTCM3;
    }
    g_glo_ifb=ifb; g_glo_lockloss_s=lockloss_s; g_glo_last=nepoch-1; g_glo_used=0;
    run_scenario(&scfg,&ecfg,nepoch,60,r,glo_hook);
    g_glo_ifb=g_glo_lockloss_s=0;
    report(name,r);
    printf("  [%s] GLONASS satellites in the solution at the end: %d\n",name,g_glo_used);
}

static void test_glonass(void)
{
    run_result_t r;

    TEST_BEGIN("GPS+GLONASS, static");
    glo_scenario("gps+glo",0,0,0,0,180,&r);
    CHECK(g_glo_used>=4,"GLONASS satellites used in the solution (%d)",g_glo_used);
    CHECK(r.first_fix_epoch>=0&&r.first_fix_epoch<60,"fixed within 60 epochs (at %d)",
          r.first_fix_epoch);
    CHECK(r.nfix>=140,"stays fixed (%d fixed epochs)",r.nfix);
    CHECK(r.rms_h>=0.0&&r.rms_h<0.05,"fixed horizontal RMS %.4f m < 5 cm",r.rms_h);
}

static void test_glonass_code_bias(void)
{
    run_result_t r;

    /* The field fault, both halves of it: GLONASS pseudoranges offset per
     * channel by metres, and the rover dropping lock on every satellite every
     * ~25 s so the filter keeps leaning on pseudoranges. At RTKLIB's stock
     * GLONASS code weight this fixed confidently on wrong integers; with
     * EFACT_GLO_CODE (rtkpico_config.h) a fix must never be wrong, even if it
     * comes less often. */
    TEST_BEGIN("GLONASS code inter-frequency biases + receiver-wide lock loss");

    glo_scenario("ifb static",0,1,25,0,300,&r);
    CHECK(r.nfix>0,"static: fixes between lock losses (%d)",r.nfix);
    CHECK(r.max_h<0.10,"static: no wrong fix (worst fixed error %.3f m)",r.max_h);

    glo_scenario("ifb kinematic",1,1,25,0,300,&r);
    CHECK(r.nfix>0,"kinematic: fixes between lock losses (%d)",r.nfix);
    CHECK(r.max_h<0.10,"kinematic: no wrong fix (worst fixed error %.3f m)",r.max_h);
}

#ifndef RTKPICO_TARGET_SUITE
static void test_glonass_rtcm3_base(void)
{
    run_result_t r;

    /* The base as the field sends it: 1005 + MSM7 1077/1087, where the rover
     * learns each GLONASS satellite's channel -- and so the base's carrier
     * wavelength -- from MSM7's extended satellite info. Host only: the
     * encoder's rtcm_t is ~95 KB of heap the target suite cannot spare. */
    TEST_BEGIN("base over RTCM3 MSM7 (1005 + 1077 + 1087)");
    glo_scenario("rtcm3",0,0,0,1,180,&r);
    CHECK(g_glo_used>=4,"GLONASS satellites used in the solution (%d)",g_glo_used);
    CHECK(r.first_fix_epoch>=0&&r.first_fix_epoch<60,"fixed within 60 epochs (at %d)",
          r.first_fix_epoch);
    CHECK(r.nfix>=140,"stays fixed (%d fixed epochs)",r.nfix);
    CHECK(r.rms_h>=0.0&&r.rms_h<0.05,"fixed horizontal RMS %.4f m < 5 cm",r.rms_h);
}
#endif
#endif

/* --- 5. baseline length --------------------------------------------------- */
/* Single-frequency RTK is limited by the ionospheric gradient. This documents
 * where accuracy starts to go, which is what decides base placement. */
static void test_baseline_lengths(void)
{
    const double km[]={0.5,2.0,10.0,30.0};
    sim_scenario_cfg_t scfg;
    rtkeng_cfg_t ecfg;
    run_result_t r;
    int i;

    TEST_BEGIN("accuracy vs baseline length (single frequency)");

    for (i=0;i<(int)(sizeof(km)/sizeof(km[0]));i++) {
        char name[32];
        sim_scenario_default(&scfg);
        /* move the rover north by the requested baseline */
        scfg.rover_llh[0]=scfg.base_llh[0]+km[i]/111.0;
        scfg.rover_llh[1]=scfg.base_llh[1];
        rtkeng_default_cfg(&ecfg);
        ecfg.mode=PMODE_STATIC;
        ecfg.dynamics=0;

        run_scenario(&scfg,&ecfg,150,50,&r,NULL);
        snprintf(name,sizeof(name),"%.1f km",km[i]);
        report(name,&r);

        if (km[i]<=2.0) {
            CHECK(r.nfix>0&&r.rms_h<0.10,
                  "%.1f km: fixes and holds %.4f m horizontal",km[i],r.rms_h);
        }
        else {
            /* Not a pass/fail bound: recorded so the operating envelope is
             * visible in the test log. */
            CHECK(r.nsol>0,"%.1f km: solutions produced (horiz RMS %.4f m, "
                  "%d fixed)",km[i],r.rms_h_all,r.nfix);
        }
    }
}

int test_rtk_suite(rtkeng_t *eng, sim_scenario_t *sim)
{
    g_eng=eng;
    g_sim=sim;
    printf("RTKLIB Pico port - RTK engine tests\n");
    printf("MAXSAT=%d NFREQ=%d MAXOBS=%d  sizeof(rtkeng_t)=%zu bytes\n",
           MAXSAT,NFREQ,MAXOBS,sizeof(rtkeng_t));
    test_static_short_baseline();
    test_kinematic();
    test_cycle_slips();
    test_half_cycle_subtracted();
    test_base_outage();
    test_baseline_lengths();
#if NSATGLO>0
    test_glonass();
    test_glonass_code_bias();
#ifndef RTKPICO_TARGET_SUITE
    test_glonass_rtcm3_base();
#endif
#endif
    TEST_SUMMARY();
    return g_tests_failed?1:0;
}

#ifndef RTKPICO_TARGET_SUITE
int main(void)
{
    /* allocated as the target runner does, so both run the same code */
    rtkeng_t *eng=(rtkeng_t *)malloc(sizeof(rtkeng_t));
    sim_scenario_t *sim=(sim_scenario_t *)malloc(sizeof(sim_scenario_t));
    int ret;
    if (!eng||!sim) { printf("cannot allocate the engine\n"); return 1; }
    ret=test_rtk_suite(eng,sim);
    free(sim);
    free(eng);
    return ret;
}
#endif
